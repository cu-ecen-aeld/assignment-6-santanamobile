## conf/local.conf
```bitbake
#MACHINE ??= "qemux86-64"
MACHINE ??= "qemuarm64"
#DL_DIR ?= "${TOPDIR}/downloads"
#SSTATE_DIR ?= "${TOPDIR}/sstate-cache"
#TMPDIR = "${TOPDIR}/tmp"
DISTRO ?= "poky"
#  - 'package_deb' for debian style deb files
#  - 'package_ipk' for ipk files are used by opkg (a debian style embedded package manager)
#  - 'package_rpm' for rpm style packages
# E.g.: PACKAGE_CLASSES ?= "package_rpm package_deb package_ipk"
# We default to rpm:
PACKAGE_CLASSES ?= "package_ipk"
#EXTRA_IMAGE_FEATURES ?= " ssh-server-dropbear"
EXTRA_IMAGE_FEATURES ?= " ssh-server-openssh"
#EXTRA_IMAGE_FEATURES ?= " debug-tweaks"
#IMAGE_INSTALL:append = ""
#USER_CLASSES ?= "buildstats"
#IMAGE_CLASSES += "testimage testsdk"
#TESTIMAGE_AUTO:qemuall = "1"
#OE_TERMINAL = "auto"
# By default disable interactive patch resolution (tasks will just fail instead):
PATCHRESOLVE = "noop"
# Disk Space Monitoring during the build
BB_DISKMON_DIRS ??= "\
    STOPTASKS,${TMPDIR},1G,100K \
    STOPTASKS,${DL_DIR},1G,100K \
    STOPTASKS,${SSTATE_DIR},1G,100K \
    STOPTASKS,/tmp,100M,100K \
    HALT,${TMPDIR},100M,1K \
    HALT,${DL_DIR},100M,1K \
    HALT,${SSTATE_DIR},100M,1K \
    HALT,/tmp,10M,1K"
#SSTATE_MIRRORS ?= "\
#file://.* https://someserver.tld/share/sstate/PATH;downloadfilename=PATH \
#file://.* file:///some/local/dir/sstate/PATH"
#BB_HASHSERVE_UPSTREAM = "hashserv.yoctoproject.org:8686"
#SSTATE_MIRRORS ?= "file://.* http://sstate.yoctoproject.org/all/PATH;downloadfilename=PATH"
PACKAGECONFIG:append:pn-qemu-system-native = " sdl"
#ASSUME_PROVIDED += "libsdl2-native"
#PACKAGECONFIG:append:pn-qemu-system-native = " gtk+"
#BB_HASHSERVE = "auto"
#BB_SIGNATURE_HANDLER = "OEEquivHash"
#BB_SERVER_TIMEOUT = "60"
CONF_VERSION = "2"

# Build optimization
PARALLEL_MAKE = "-j 2"
BB_NUMBER_THREADS = "2"
BB_NUMBER_PARSE_THREADS = "4"
XZ_DEFAULTS = "--memlimit=1024MiB"
#XZ_DEFAULTS = "--memlimit=2048MiB"
INHERIT += "rm_work"

# Instrui utilizacao de ccache
INHERIT += "ccache"
CCACHE_DIR = "/home/operador/.ccache"
MACHINE = "qemuarm64"
```
